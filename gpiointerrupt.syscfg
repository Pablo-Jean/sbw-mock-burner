/**
 * @cliArgs --board "/ti/boards/CC26X2R1_LAUNCHXL" --rtos "tirtos7" --product "simplelink_cc13xx_cc26xx_sdk@5.40.00.40"
 * @versions {"tool":"1.13.0+2553"}
 */

/**
 * Import the modules used in this configuration.
 */
const GPIO        = scripting.addModule("/ti/drivers/GPIO");
const GPIO1       = GPIO.addInstance();
const GPIO2       = GPIO.addInstance();
const GPIO3       = GPIO.addInstance();
const GPIO4       = GPIO.addInstance();
const GPIO5       = GPIO.addInstance();
const GPIO6       = GPIO.addInstance();
const GPIO7       = GPIO.addInstance();
const GPIO8       = GPIO.addInstance();
const GPIO9       = GPIO.addInstance();
const Power       = scripting.addModule("/ti/drivers/Power");
const Timer       = scripting.addModule("/ti/drivers/Timer", {}, false);
const Timer1      = Timer.addInstance();
const Settings    = scripting.addModule("/ti/posix/tirtos/Settings");
const BIOS        = scripting.addModule("/ti/sysbios/BIOS");
const Clock       = scripting.addModule("/ti/sysbios/knl/Clock");
const Event       = scripting.addModule("/ti/sysbios/knl/Event");
const Idle        = scripting.addModule("/ti/sysbios/knl/Idle", {}, false);
const Idle2       = Idle.addInstance();
const Mailbox     = scripting.addModule("/ti/sysbios/knl/Mailbox");
const Error       = scripting.addModule("/ti/sysbios/runtime/Error");
const SysCallback = scripting.addModule("/ti/sysbios/runtime/SysCallback");
const Timestamp   = scripting.addModule("/ti/sysbios/runtime/Timestamp");

/**
 * Write custom configuration values to the imported modules.
 */
GPIO1.$hardware = system.deviceData.board.components["BTN-1"];
GPIO1.$name     = "CONFIG_GPIO_BUTTON_0";

GPIO2.$hardware = system.deviceData.board.components["BTN-2"];
GPIO2.$name     = "CONFIG_GPIO_BUTTON_1";

GPIO3.$name           = "TMS";
GPIO3.mode            = "Output";
GPIO3.gpioPin.$assign = "boosterpack.8";

GPIO4.$name           = "TCK";
GPIO4.mode            = "Output";
GPIO4.gpioPin.$assign = "boosterpack.11";

GPIO5.$name              = "RESET";
GPIO5.mode               = "Output";
GPIO5.initialOutputState = "High";
GPIO5.gpioPin.$assign    = "boosterpack.27";

GPIO6.$hardware = system.deviceData.board.components.LED_RED;
GPIO6.$name     = "CONFIG_GPIO_LED_0";

GPIO7.$hardware = system.deviceData.board.components.LED_GREEN;
GPIO7.$name     = "CONFIG_GPIO_LED_1";

GPIO8.mode            = "Output";
GPIO8.$name           = "TDI";
GPIO8.gpioPin.$assign = "boosterpack.19";

GPIO9.$name           = "TDO";
GPIO9.gpioPin.$assign = "boosterpack.18";

const CCFG              = scripting.addModule("/ti/devices/CCFG", {}, false);
CCFG.ccfgTemplate.$name = "ti_devices_CCFG_CCFGCC26XXTemplate0";

Timer1.$name               = "TIMER_0";
Timer1.interruptPriority   = "4";
Timer1.timerInstance.$name = "CONFIG_GPTIMER_0";

BIOS.assertsEnabled = false;
BIOS.heapBaseAddr   = "__primary_heap_start__";
BIOS.heapEndAddr    = "__primary_heap_end__";

const Hwi           = scripting.addModule("/ti/sysbios/family/arm/m3/Hwi", {}, false);
Hwi.enableException = false;

const Timer_1 = scripting.addModule("/ti/sysbios/family/arm/cc26xx/Timer", {}, false);

Idle2.$name   = "powerIdle";
Idle2.idleFxn = "Power_idleFunc";

const Semaphore            = scripting.addModule("/ti/sysbios/knl/Semaphore", {}, false);
Semaphore.supportsPriority = false;

const Swi         = scripting.addModule("/ti/sysbios/knl/Swi", {}, false);
Swi.numPriorities = 6;

const Task             = scripting.addModule("/ti/sysbios/knl/Task", {}, false);
Task.defaultStackSize  = 512;
Task.idleTaskStackSize = 512;
Task.numPriorities     = 6;

Error.policy       = "Error_SPIN";
Error.printDetails = false;

const System           = scripting.addModule("/ti/sysbios/runtime/System", {}, false);
System.abortFxn        = "System_abortSpin";
System.exitFxn         = "System_exitSpin";
System.extendedFormats = "%f";
System.supportModule   = "SysCallback";

/**
 * Pinmux solution for unlocked pins/peripherals. This ensures that minor changes to the automatic solver in a future
 * version of the tool will not impact the pinmux you originally saw.  These lines can be completely deleted in order to
 * re-solve from scratch.
 */
GPIO1.gpioPin.$suggestSolution              = "boosterpack.13";
GPIO2.gpioPin.$suggestSolution              = "boosterpack.12";
GPIO6.gpioPin.$suggestSolution              = "boosterpack.39";
GPIO7.gpioPin.$suggestSolution              = "boosterpack.40";
Timer1.timerInstance.timer.$suggestSolution = "GPTM0";
Timer_1.rtc.$suggestSolution                = "RTC0";
